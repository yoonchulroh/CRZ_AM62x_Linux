// SPDX-License-Identifier: GPL-2.0
/*
 * AM625 SK dts file for R5 SPL
 * Copyright (C) 2021-2022 Texas Instruments Incorporated - https://www.ti.com/
 */

#include "k3-am625-sk.dts"
#include "k3-am62x-sk-ddr4-1600MTs.dtsi"
#include "k3-am62-ddr.dtsi"

#include "k3-am625-sk-u-boot.dtsi"
#include "k3-am625-r5.dtsi"

/delete-node/ &framebuffer0;
/delete-node/ &dss;
/delete-node/ &microtips_mf101hie_panel;
/delete-node/ &sii9022;
/delete-node/ &hdmi0;
/delete-node/ &panel_lvds;

/ {
    dummy_133mhz_clk: clock {
        #clock-cells = <0>;
        compatible = "fixed-clock";
        clock-frequency = <133333333>;
        bootph-pre-ram;
    };
};

&elm0 {
    /delete-property/ power-domains;
};

&gpmc0 {
    /delete-property/ power-domains;
    clocks = <&dummy_133mhz_clk>;
};
